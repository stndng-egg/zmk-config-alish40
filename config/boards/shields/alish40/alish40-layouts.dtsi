#include <dt-bindings/zmk/matrix_transform.h>

/ {
    zmk_key_physical_attrs: zmk_key_physical_attrs {
        compatible = "zmk,key-physical-attrs";
        #key-cells = <7>;
    };

    phys_layout: phys_layout {
        compatible = "zmk,physical-layout";
        display-name = "Default Layout";
        transform = <&default_transform>;
        kscan = <&default_kscan>;
        keys
            = <&zmk_key_physical_attrs 150 100 0 0 0 0 0>, <&zmk_key_physical_attrs 100 100 150 0 0 0 0>, <&zmk_key_physical_attrs 100 100 250 0 0 0 0>, <&zmk_key_physical_attrs 100 100 350 0 0 0 0>, <&zmk_key_physical_attrs 100 100 450 0 0 0 0>, <&zmk_key_physical_attrs 100 100 550 0 0 0 0>, <&zmk_key_physical_attrs 100 100 750 0 0 0 0>, <&zmk_key_physical_attrs 100 100 850 0 0 0 0>, <&zmk_key_physical_attrs 100 100 950 0 0 0 0>, <&zmk_key_physical_attrs 100 100 1050 0 0 0 0>, <&zmk_key_physical_attrs 100 100 1150 0 0 0 0>, <&zmk_key_physical_attrs 150 100 1250 0 0 0 0>
            , <&zmk_key_physical_attrs 175 100 0 100 0 0 0>, <&zmk_key_physical_attrs 100 100 175 100 0 0 0>, <&zmk_key_physical_attrs 100 100 275 100 0 0 0>, <&zmk_key_physical_attrs 100 100 375 100 0 0 0>, <&zmk_key_physical_attrs 100 100 475 100 0 0 0>, <&zmk_key_physical_attrs 100 100 575 100 0 0 0>, <&zmk_key_physical_attrs 100 100 775 100 0 0 0>, <&zmk_key_physical_attrs 100 100 875 100 0 0 0>, <&zmk_key_physical_attrs 100 100 975 100 0 0 0>, <&zmk_key_physical_attrs 100 100 1075 100 0 0 0>, <&zmk_key_physical_attrs 100 100 1175 100 0 0 0>, <&zmk_key_physical_attrs 125 100 1275 100 0 0 0>
            , <&zmk_key_physical_attrs 225 100 0 200 0 0 0>, <&zmk_key_physical_attrs 100 100 225 200 0 0 0>, <&zmk_key_physical_attrs 100 100 325 200 0 0 0>, <&zmk_key_physical_attrs 100 100 425 200 0 0 0>, <&zmk_key_physical_attrs 100 100 525 200 0 0 0>, <&zmk_key_physical_attrs 100 100 625 200 0 0 0>, <&zmk_key_physical_attrs 100 100 725 200 0 0 0>, <&zmk_key_physical_attrs 100 100 825 200 0 0 0>, <&zmk_key_physical_attrs 100 100 925 200 0 0 0>, <&zmk_key_physical_attrs 100 100 1025 200 0 0 0>, <&zmk_key_physical_attrs 100 100 1125 200 0 0 0>, <&zmk_key_physical_attrs 175 100 1225 200 0 0 0>
            , <&zmk_key_physical_attrs 125 100 0 300 0 0 0>, <&zmk_key_physical_attrs 125 100 125 300 0 0 0>, <&zmk_key_physical_attrs 125 100 350 300 0 0 0>, <&zmk_key_physical_attrs 225 100 475 300 0 0 0>, <&zmk_key_physical_attrs 275 100 700 300 0 0 0>, <&zmk_key_physical_attrs 125 100 975 300 0 0 0>, <&zmk_key_physical_attrs 125 100 1150 300 0 0 0>, <&zmk_key_physical_attrs 125 100 1275 300 0 0 0>
            ;
    };
};
